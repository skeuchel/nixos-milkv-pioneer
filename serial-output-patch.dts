/dts-v1/;
/plugin/;
/ {
    compatible = "sophgo,mango";
    fragment@0 {
        target-path = "/chosen";
        __overlay__ {
            bootargs = "earlycon console=ttyS0,115200";
        };
    };
};
